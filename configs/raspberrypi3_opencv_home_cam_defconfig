## configs/raspberrypi3_opencv_home_cam_defconfig
```kconfig
BR2_arm=y
BR2_cortex_a53=y
BR2_ARM_FPU_NEON_VFPV4=y
BR2_TOOLCHAIN_BUILDROOT_GLIBC=y
BR2_PACKAGE_HOST_LINUX_HEADERS_CUSTOM_4_9=y
BR2_TOOLCHAIN_BUILDROOT_CXX=y
BR2_TARGET_GENERIC_HOSTNAME="buildroot-opencv-home-cam"
BR2_ROOTFS_DEVICE_CREATION_DYNAMIC_EUDEV=y
BR2_TARGET_GENERIC_ROOT_PASSWD="root"
BR2_SYSTEM_DHCP="wlan0"
BR2_ROOTFS_OVERLAY="board/raspberrypi/rootfs-overlay-opencv-home-cam"
BR2_ROOTFS_POST_BUILD_SCRIPT="board/raspberrypi3/post-build.sh"
BR2_ROOTFS_POST_IMAGE_SCRIPT="board/raspberrypi3/post-image.sh"
BR2_ROOTFS_POST_SCRIPT_ARGS="--add-pi3-miniuart-bt-overlay --enable-camera"
BR2_LINUX_KERNEL=y
BR2_LINUX_KERNEL_CUSTOM_GIT=y
BR2_LINUX_KERNEL_CUSTOM_REPO_URL="https://github.com/raspberrypi/linux.git"
BR2_LINUX_KERNEL_CUSTOM_REPO_VERSION="9126e25b0934bd7bd843763310ea4b34c6e139d0"
BR2_LINUX_KERNEL_DEFCONFIG="bcm2709"
BR2_LINUX_KERNEL_DTS_SUPPORT=y
BR2_LINUX_KERNEL_INTREE_DTS_NAME="bcm2710-rpi-3-b bcm2710-rpi-cm3"
BR2_PACKAGE_LINUX_TOOLS_PERF=y
BR2_PACKAGE_BUSYBOX_CONFIG_FRAGMENT_FILES="board/raspberrypi/opencv-busybox-fragment.config"
BR2_PACKAGE_RPI_FIRMWARE=y
BR2_PACKAGE_RPI_WIFI_FIRMWARE=y
BR2_PACKAGE_PERL_IO_SOCKET_SSL=y
BR2_PACKAGE_PYTHON3=y
BR2_PACKAGE_PYTHON_OPENCV_HOME_CAM=y
BR2_PACKAGE_PYTHON_OPENCV_HOME_CAM_SIMPLE_MOTION_DETECTOR=y
BR2_PACKAGE_PYTHON_OPENCV_HOME_CAM_SEND_EMAIL_ACTION=y
BR2_PACKAGE_PYTHON_SETUPTOOLS=y
BR2_PACKAGE_CA_CERTIFICATES=y
BR2_PACKAGE_OPENCV3=y
BR2_PACKAGE_OPENCV3_LIB_OBJDETECT=y
BR2_PACKAGE_OPENCV3_LIB_PYTHON=y
BR2_PACKAGE_OPENCV3_LIB_VIDEOIO=y
BR2_PACKAGE_OPENCV3_WITH_FFMPEG=y
BR2_PACKAGE_OPENCV3_WITH_JPEG=y
BR2_PACKAGE_OPENCV3_WITH_V4L=y
BR2_PACKAGE_SENDEMAIL=y
BR2_PACKAGE_DROPBEAR=y
BR2_PACKAGE_NTP=y
BR2_PACKAGE_WPA_SUPPLICANT=y
BR2_PACKAGE_WPA_SUPPLICANT_CLI=y
BR2_PACKAGE_WPA_SUPPLICANT_WPA_CLIENT_SO=y
BR2_PACKAGE_WPA_SUPPLICANT_PASSPHRASE=y
BR2_TARGET_ROOTFS_EXT2=y
BR2_TARGET_ROOTFS_EXT2_4=y
BR2_TARGET_ROOTFS_EXT2_SIZE="200M"
# BR2_TARGET_ROOTFS_TAR is not set
BR2_PACKAGE_HOST_DOSFSTOOLS=y
BR2_PACKAGE_HOST_GENIMAGE=y
BR2_PACKAGE_HOST_MTOOLS=y
```

## package/python-imutils/Config.in
```kconfig
config BR2_PACKAGE_PYTHON_IMUTILS
	bool "python-imutils"
	help
	  A series of convenience functions to make basic image processing
	  functions such as translation, rotation, resizing, skeletonization,
	  displaying Matplotlib images, sorting contours, detecting edges,
	  and much more easier with OpenCV and both Python 2.7 and Python 3.

	  https://github.com/jrosebr1/imutils
```

## package/python-opencv-home-cam/Config.in
```kconfig
config BR2_PACKAGE_PYTHON_OPENCV_HOME_CAM
	bool "python-opencv-home-cam"
	select BR2_PACKAGE_PYTHON_IMUTILS
	help
	  A simple opencv object detection framework.

	  https://github.com/erstrom/opencv-home-cam

if BR2_PACKAGE_PYTHON_OPENCV_HOME_CAM

choice

	bool "Detector to use"

config BR2_PACKAGE_PYTHON_OPENCV_HOME_CAM_HAAR_CASCADE_DETECTOR
	bool "Haar cascade detector"

config BR2_PACKAGE_PYTHON_OPENCV_HOME_CAM_SIMPLE_MOTION_DETECTOR
	bool "Simple motion detector"
	help
	  The simple motion detector will diff consecutive frames
	  captured by the camera and check if there are any significant
	  differences.

config BR2_PACKAGE_PYTHON_OPENCV_HOME_CAM_HOG_PEOPLE_DETECTOR
	bool "HOG people detector"
	help
	  The HOG people detector will use the OpenCV built-in HOG
	  people detector to detect pedestrians.

endchoice

config BR2_PACKAGE_PYTHON_OPENCV_HOME_CAM_SEND_EMAIL_ACTION
	bool "Enable sendemail action"
	default n

if BR2_PACKAGE_PYTHON_OPENCV_HOME_CAM_SEND_EMAIL_ACTION

config BR2_PACKAGE_PYTHON_OPENCV_HOME_CAM_SEND_EMAIL_ACTION_FROM_ADDR
	string "From-address"
	default ""
	help
	  The address from which the email will be sent.

config BR2_PACKAGE_PYTHON_OPENCV_HOME_CAM_SEND_EMAIL_ACTION_TO_ADDR
	string "To-address"
	default ""
	help
	  The address(es) to which the email will be sent.
	  Several addresses shall be separated with spaces.

config BR2_PACKAGE_PYTHON_OPENCV_HOME_CAM_SEND_EMAIL_SMTP_SERVER
	string "SMTP server"
	default "smtp.gmail.com:587"
	help
	  The SMTP server that sendemail will connect to.

config BR2_PACKAGE_PYTHON_OPENCV_HOME_CAM_SEND_EMAIL_SMTP_PASSWD
	string "SMTP password"
	default ""
	help
	  The password (clear text) that will be used to authenticate with the
	  SMTP server.

endif

endif
```

## package/sendemail/Config.in
```kconfig
config BR2_PACKAGE_SENDEMAIL
	bool "sendemail"
	select BR2_PACKAGE_PERL
	help
	  SendEmail - Lightweight, command line SMTP email client

	  http://caspian.dotconf.net/menu/Software/SendEmail/
```
